## viewer/build/Kconfig/arch/Kconfig
```kconfig
# Load Zephyr Arch Kconfig descriptions.
osource "/home/james/csse4011/repo/zephyr/arch/x86/Kconfig"
osource "/home/james/csse4011/repo/zephyr/arch/xtensa/Kconfig"
osource "/home/james/csse4011/repo/zephyr/arch/sparc/Kconfig"
osource "/home/james/csse4011/repo/zephyr/arch/riscv/Kconfig"
osource "/home/james/csse4011/repo/zephyr/arch/posix/Kconfig"
osource "/home/james/csse4011/repo/zephyr/arch/nios2/Kconfig"
osource "/home/james/csse4011/repo/zephyr/arch/mips/Kconfig"
osource "/home/james/csse4011/repo/zephyr/arch/arm64/Kconfig"
osource "/home/james/csse4011/repo/zephyr/arch/arm/Kconfig"
osource "/home/james/csse4011/repo/zephyr/arch/arc/Kconfig"
```

## viewer/build/Kconfig/boards/Kconfig
```kconfig
# Load Zephyr board Kconfig descriptions.
osource "/home/james/csse4011/repo/zephyr/boards/m5stack/m5stack_core2/Kconfig"
```

## viewer/build/Kconfig/boards/Kconfig.defconfig
```kconfig
# Load Zephyr board defconfig descriptions.
osource "/home/james/csse4011/repo/zephyr/boards/m5stack/m5stack_core2/Kconfig.defconfig"
```
