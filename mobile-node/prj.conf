## CMakeLists.txt
```
cmake_minimum_required(VERSION 3.20.0)
find_package(Zephyr REQUIRED HINTS $ENV{ZEPHYR_BASE})
project(mobile-node)

target_sources(app PRIVATE 
src/main.c 
src/sensor.c
src/bluetooth.c
)

target_include_directories(app PRIVATE include)
```

## prj.conf
```kconfig
# Bluetooth
CONFIG_BT=y
CONFIG_BT_PERIPHERAL=y
CONFIG_BT_DEVICE_NAME="GreenhouseThingy52"

# Sensor drivers
CONFIG_SENSOR=y
CONFIG_HTS221=y
CONFIG_CCS811=y

# Logging
CONFIG_LOG=y
```

## boards/thingy52_nrf52832.overlay
```dts
/ {
    aliases {
        hts221 = &hts221;
        ccs811 = &ccs811;
    };
};
```

## src/main.c
```c
#include <zephyr/kernel.h>
#include <zephyr/logging/log.h>
#include "sensor.h"
#include "bluetooth.h"

LOG_MODULE_REGISTER(main_app, LOG_LEVEL_INF);

int main(void) {
    LOG_INF("Greenhouse Thingy52 starting...");

    sensor_task_start();       // Start threaded sensor sampling
    bluetooth_init();          // Initialise BLE
    bluetooth_task_start();    // Start threaded BLE advertiser

    // Main thread sleeps forever — all work is done in threads
    while (1) {
        k_sleep(K_FOREVER);
    }

    return 0;
}
```

## include/bluetooth.h
```c
#ifndef BLUETOOTH_H
#define BLUETOOTH_H

#include "sensor.h"

// Initialise Bluetooth stack and start advertising
void bluetooth_init(void);

// Start BLE advertiser thread (added for background BLE updates)
void bluetooth_task_start(void);

// Update the advertising payload with latest sensor values (optional if used elsewhere)
void bluetooth_update_payload(struct greenhouse_data *data);

#endif // BLUETOOTH_H
```

## include/sensor.h
```c
#ifndef SENSOR_H
#define SENSOR_H

#include <zephyr/drivers/sensor.h>
#include <zephyr/kernel.h>

struct greenhouse_data {
    struct sensor_value temperature;
    struct sensor_value co2;
    struct sensor_value humidity;
};

extern struct greenhouse_data ghs_data;
extern struct k_mutex ghs_mutex;

void sensor_task_start(void);

#endif // SENSOR_H
```

## src/bluetooth.c
```c
#include "bluetooth.h"
#include "sensor.h"
#include <zephyr/bluetooth/bluetooth.h>
#include <zephyr/bluetooth/hci.h>
#include <zephyr/kernel.h>
#include <zephyr/logging/log.h>

LOG_MODULE_REGISTER(ble_module, LOG_LEVEL_INF);

// 9 bytes: 2 for Company ID, 1 for App ID, 6 for sensor data
static uint8_t adv_payload[9] = {
    0xAF, 0x6F,    // Company ID: 0x6FAF (little endian)
    0xBB,          // App ID for mobile node
    0x00, 0x00,    // Temperature (to be filled)
    0x00, 0x00,    // CO2 (to be filled)
    0x00, 0x00     // Humidity (to be filled)
};

static struct bt_data ad[] = {
    BT_DATA_BYTES(BT_DATA_FLAGS, (BT_LE_AD_GENERAL | BT_LE_AD_NO_BREDR)),
    BT_DATA(BT_DATA_MANUFACTURER_DATA, adv_payload, sizeof(adv_payload)),
};

// BLE advertiser thread
#define BLE_STACK_SIZE 1024
#define BLE_PRIORITY   5
K_THREAD_STACK_DEFINE(ble_stack, BLE_STACK_SIZE);
static struct k_thread ble_thread_data;

static void bluetooth_thread_fn(void *a, void *b, void *c) {
    struct greenhouse_data snapshot;

    while (1) {
        // Copy shared sensor data
        k_mutex_lock(&ghs_mutex, K_FOREVER);
        snapshot = ghs_data;
        k_mutex_unlock(&ghs_mutex);

        // Encode values
        int16_t temp = snapshot.temperature.val1 * 100 + snapshot.temperature.val2 / 10000;
        uint16_t co2 = snapshot.co2.val1;
        uint16_t humid = snapshot.humidity.val1 * 100 + snapshot.humidity.val2 / 10000;

        adv_payload[3] = temp >> 8;
        adv_payload[4] = temp & 0xFF;
        adv_payload[5] = co2 >> 8;
        adv_payload[6] = co2 & 0xFF;
        adv_payload[7] = humid >> 8;
        adv_payload[8] = humid & 0xFF;

        // Update BLE advertisement
        bt_le_adv_update_data(ad, ARRAY_SIZE(ad), NULL, 0);

        // should update to be JSON format
        LOG_INF("BLE Update: Temp=%d.%02d°C, CO₂=%dppm, Humidity=%d.%02d%%",
                snapshot.temperature.val1, snapshot.temperature.val2 / 10000,
                co2,
                snapshot.humidity.val1, snapshot.humidity.val2 / 10000);

        k_sleep(K_SECONDS(5));
    }
}

void bluetooth_init(void) {
    int err = bt_enable(NULL);
    if (err) {
        LOG_ERR("Bluetooth init failed (err %d)", err);
        return;
    }

    const struct bt_le_adv_param *adv_params = BT_LE_ADV_PARAM(
        BT_LE_ADV_OPT_USE_NAME,
        BT_GAP_ADV_FAST_INT_MIN_2,
        BT_GAP_ADV_FAST_INT_MAX_2,
        NULL
    );

    err = bt_le_adv_start(adv_params, ad, ARRAY_SIZE(ad), NULL, 0);
    if (err) {
        LOG_ERR("BLE advertising start failed (err %d)", err);
        return;
    }

    LOG_INF("BLE advertising started");
}

void bluetooth_task_start(void) {
    k_thread_create(&ble_thread_data, ble_stack, BLE_STACK_SIZE,
                    bluetooth_thread_fn, NULL, NULL, NULL,
                    BLE_PRIORITY, 0, K_NO_WAIT);
    k_thread_name_set(&ble_thread_data, "ble_adv_thread");
}
```

## src/sensor.c
```c
#include "sensor.h"
#include <zephyr/kernel.h>
#include <zephyr/logging/log.h>
#include <zephyr/device.h>
#include <zephyr/devicetree.h>
#include <zephyr/drivers/sensor.h>

LOG_MODULE_REGISTER(sensor_module, LOG_LEVEL_INF);

static const struct device *temp_dev;
static const struct device *gas_dev;

struct greenhouse_data ghs_data;
struct k_mutex ghs_mutex;

#define SENSOR_STACK_SIZE 1024
#define SENSOR_PRIORITY 5
K_THREAD_STACK_DEFINE(sensor_stack, SENSOR_STACK_SIZE);
static struct k_thread sensor_thread_data;

static void sensor_thread_fn(void *a, void *b, void *c) {
    struct sensor_value temp, co2, humid;

    while (1) {
        if (sensor_sample_fetch(temp_dev) == 0 &&
            sensor_channel_get(temp_dev, SENSOR_CHAN_AMBIENT_TEMP, &temp) == 0 &&
            sensor_channel_get(temp_dev, SENSOR_CHAN_HUMIDITY, &humid) == 0 &&
            sensor_sample_fetch(gas_dev) == 0 &&
            sensor_channel_get(gas_dev, SENSOR_CHAN_CO2, &co2) == 0) {

            k_mutex_lock(&ghs_mutex, K_FOREVER);
            ghs_data.temperature = temp;
            ghs_data.humidity = humid;
            ghs_data.co2 = co2;
            k_mutex_unlock(&ghs_mutex);

            LOG_INF("Temp: %d.%06d°C | Humidity: %d.%06d%% | CO₂: %dppm",
                    temp.val1, temp.val2,
                    humid.val1, humid.val2,
                    co2.val1);
        } else {
            LOG_ERR("Sensor fetch failed");
        }

        k_sleep(K_SECONDS(5));
    }
}

void sensor_task_start(void) {
    temp_dev = DEVICE_DT_GET(DT_ALIAS(hts221));
    gas_dev  = DEVICE_DT_GET(DT_ALIAS(ccs811));

    if (!device_is_ready(temp_dev) || !device_is_ready(gas_dev)) {
        LOG_ERR("Sensors not ready");
        return;
    }

    k_mutex_init(&ghs_mutex);

    k_thread_create(&sensor_thread_data, sensor_stack, SENSOR_STACK_SIZE,
                    sensor_thread_fn, NULL, NULL, NULL,
                    SENSOR_PRIORITY, 0, K_NO_WAIT);
    k_thread_name_set(&sensor_thread_data, "sensor_thread");

    LOG_INF("Sensor thread started");
}
```
